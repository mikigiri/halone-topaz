## boards/shields/halone_topaz/Kconfig.defconfig
```kconfig
if SHIELD_HALONE_TOPAZ

config ZMK_KEYBOARD_NAME
    default "Halone Topaz"

endif
```

## config/west.yml
```yaml
manifest:
  defaults:
    revision: v0.3
  remotes:
    - name: mikigiri
      url-base: https://github.com/mikigiri
    - name: badjeff
      url-base: https://github.com/badjeff
    # Additional modules containing boards/shields/custom code can be listed here as well
    # See https://docs.zephyrproject.org/3.2.0/develop/west/manifest.html#projects
  projects:
    - name: zmk
      remote: mikigiri
      import: app/west.yml
    - name: zmk-analog-input-driver
      remote: badjeff
      revision: main
    - name: zmk-hid-io
      remote: badjeff
      revision: main
  self:
    path: config
```
